## subsys/debug/signal_gen/Kconfig
```kconfig
#
# Copyright (c) 2021 Nordic Semiconductor
#
# SPDX-License-Identifier: LicenseRef-Nordic-5-Clause
#

menuconfig SIGNAL_GEN
	bool "Enable signal generator"
	help
	  Enable the signal generator. This tool generates values of the user
	  defined signals that correspond to current system uptime.

if SIGNAL_GEN

module = SIGNAL_GEN
module-str = Signal generator
source "${ZEPHYR_BASE}/subsys/logging/Kconfig.template.log_config"

endif # SIGNAL_GEN
```

## sysbuild/Kconfig.matter
```kconfig
# Copyright (c) 2024 Nordic Semiconductor
#
# SPDX-License-Identifier: LicenseRef-Nordic-5-Clause

menu "Matter"

config MATTER_FACTORY_DATA
	bool "Create matter factory data"
	help
	  Include matter factory data.

if MATTER_FACTORY_DATA

config MATTER_FACTORY_DATA_MERGE_WITH_FIRMWARE
	bool "Merge generated factory data with merged.hex output"
	default y
	help
	  Enables merging the generated factory data with the merged.hex output
	  build file. As a result, the merged.hex build output file, which is used
	  when flashing the firmware using the west tool, includes the factory data
	  as well.

config MATTER_OTA
	bool "Matter OTA Software Update"
	default y
	depends on PARTITION_MANAGER
	help
	  Enables over-the-air (OTA) Requestor role that allows the node to perform
	  Device Firmware Upgrade by quering and downloading a new firmware image
	  from a peer OTA Provider node.

config MATTER_OTA_IMAGE_FILE_NAME
	string "OTA image file name"
	default "matter.ota"
	depends on MATTER_OTA
	help
	  Provides the file name of the generated Matter OTA image.

endif # MATTER_FACTORY_DATA

endmenu
```

## tests/lib/edge_impulse/testcase.yaml
```yaml
tests:
  edge_impulse.ei_ncs:
    platform_allow: nrf52840dk_nrf52840 nrf52dk_nrf52832
    tags: edge_impulse
```

## tests/subsys/bluetooth/fast_pair/crypto/Kconfig
```kconfig
#
# Copyright (c) 2022 Nordic Semiconductor
#
# SPDX-License-Identifier: LicenseRef-Nordic-5-Clause
#

menu "Test configuration"
source "$(ZEPHYR_NRF_MODULE_DIR)/subsys/bluetooth/services/fast_pair/fp_crypto/Kconfig.fp_crypto"
endmenu

if BUILD_WITH_TFM

choice TFM_PROFILE_TYPE
	default TFM_PROFILE_TYPE_NOT_SET
	help
	  The minimal TFM build profile is not configurable and cannot be used.
endchoice

endif # BUILD_WITH_TFM

menu "Zephyr"
source "Kconfig.zephyr"
endmenu
```

## tests/subsys/bluetooth/fast_pair/crypto/testcase.yaml
```yaml
tests:
  fast_pair.crypto.mbedtls:
    platform_allow:
      nrf52dk_nrf52832 nrf52840dk_nrf52840 nrf5340dk_nrf5340_cpuapp
    integration_platforms:
      - nrf52dk_nrf52832
      - nrf52840dk_nrf52840
      - nrf5340dk_nrf5340_cpuapp
    extra_args: CONF_FILE=prj_mbedtls.conf
  fast_pair.crypto.oberon:
    platform_allow:
      nrf52dk_nrf52832 nrf52840dk_nrf52840 nrf5340dk_nrf5340_cpuapp nrf9160dk_nrf9160_ns
    integration_platforms:
      - nrf52dk_nrf52832
      - nrf52840dk_nrf52840
      - nrf5340dk_nrf5340_cpuapp
      - nrf9160dk_nrf9160_ns
  fast_pair.crypto.nrf_security:
    platform_allow: >
      nrf52dk_nrf52832 nrf52840dk_nrf52840 nrf5340dk_nrf5340_cpuapp nrf5340dk_nrf5340_cpuapp_ns
      nrf9160dk_nrf9160_ns
    integration_platforms:
      - nrf52dk_nrf52832
      - nrf52840dk_nrf52840
      - nrf5340dk_nrf5340_cpuapp
      - nrf5340dk_nrf5340_cpuapp_ns
      - nrf9160dk_nrf9160_ns
    extra_args: CONF_FILE=prj_nrf_security.conf
  fast_pair.crypto.tinycrypt:
    platform_allow:
      nrf52dk_nrf52832 nrf52840dk_nrf52840 nrf5340dk_nrf5340_cpuapp nrf9160dk_nrf9160_ns
      qemu_cortex_m3
    integration_platforms:
      - nrf52dk_nrf52832
      - nrf52840dk_nrf52840
      - nrf5340dk_nrf5340_cpuapp
      - nrf9160dk_nrf9160_ns
      - qemu_cortex_m3
    extra_args: CONF_FILE=prj_tinycrypt.conf
```
