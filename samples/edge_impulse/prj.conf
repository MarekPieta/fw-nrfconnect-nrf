## CMakeLists.txt
```
#
# Copyright (c) 2020 Nordic Semiconductor
#
# SPDX-License-Identifier: LicenseRef-BSD-5-Clause-Nordic
#

cmake_minimum_required(VERSION 3.13.1)

find_package(Zephyr REQUIRED HINTS $ENV{ZEPHYR_BASE})

project("Edge Impulse sample")

target_sources(app PRIVATE src/main.cpp)
target_include_directories(app PRIVATE include/)
```

## sample.yaml
```
sample:
  name: Edge Impulse sample
  description: A sample demonstrating Edge Impulse integration to NCS
tests:
  samples.edge_impulse:
    build_only: true
    build_on_all: true
    platform_allow: nrf52840dk_nrf52840 nrf52dk_nrf52832
    tags: ci_build
```

## prj.conf
```kconfig
# Required by Edge Impulse library
CONFIG_CPLUSPLUS=y
CONFIG_LIB_CPLUSPLUS=y
CONFIG_NEWLIB_LIBC=y
CONFIG_NEWLIB_LIBC_FLOAT_PRINTF=y
CONFIG_STD_CPP11=y
CONFIG_FPU=y

CONFIG_MAIN_STACK_SIZE=8192
CONFIG_CONSOLE_SUBSYS=y
CONFIG_CONSOLE_GETLINE=y

CONFIG_ASSERT=y
CONFIG_RESET_ON_FATAL_ERROR=n

CONFIG_EDGE_IMPULSE=y
CONFIG_EDGE_IMPULSE_BUILD_FROM_URI=y
CONFIG_EDGE_IMPULSE_DOWNLOAD_URI="https://studio.edgeimpulse.com/v1/api/10607/deployment/download?type=zip"
```

## src/main.cpp
```c
#include <zephyr.h>

#include "features.h"
#include <ei_ncs.h>


void result_ready_cb(int err)
{
	int e = ei_ncs_add_data(features, ARRAY_SIZE(features));
	__ASSERT_NO_MSG(!e);
	k_msleep(1000);
	e = ei_ncs_start_prediction(0, ARRAY_SIZE(features)/ei_ncs_get_frame_size());
	__ASSERT_NO_MSG(!e);
}

void main(void)
{
	ei_ncs_init(result_ready_cb);
	int e = ei_ncs_add_data(features, ARRAY_SIZE(features));
	__ASSERT_NO_MSG(!e);
	e = ei_ncs_start_prediction(0, ARRAY_SIZE(features)/ei_ncs_get_frame_size());
	__ASSERT_NO_MSG(!e);
}
```

## include/features.h
```c
static const float features[] = {
    // copy raw features here (for example from the 'Live classification' page)
    // see https://docs.edgeimpulse.com/docs/running-your-impulse-zephyr
-5.7343, 1.8843, 10.1829, -3.4142, -0.2993, 7.8987, 0.0934, -6.6178, 11.3273, -0.8236, -6.3688, 11.1238, -0.7901, -6.1653, 8.7008, -0.9984, -5.5858, 9.4957, -0.7781, -5.0687, 8.4997, -0.4884, -3.8620, 10.0176, -3.4142, -2.4086, 9.6801, -3.8452, -1.8508, 9.6393, -4.0248, -1.7239, 9.0001, -4.0870, -1.6473, 9.2682, -4.0870, -1.6473, 9.2682, -2.3847, -2.3392, 9.5891, -1.8747, -3.5938, 9.6872, -0.5172, -4.3145, 9.8405, -1.1157, -3.0455, 9.9075, -2.1525, -3.1413, 9.2898, -1.5491, -3.4214, 9.4143, -2.1094, -3.0024, 9.9865, -1.9849, -2.9234, 9.2802, -2.1285, -2.1237, 9.7662, -1.6616, -1.8244, 9.6274, -0.9601, -1.2666, 9.5603, -0.0575, -1.1780, 9.1940, -0.1963, -0.9673, 9.6130, -0.4405, -1.0750, 9.2060, -0.5674, -1.0271, 9.9099, 0.2801, -0.9170, 9.6465, 0.8787, -1.2091, 9.6681, 1.2426, -1.6425, 9.7255, 0.8236, -1.7718, 9.6010, -1.3264, -1.8963, 9.5627, -1.5659, -1.8244, 9.5244, -0.9122, -1.8963, 9.7088, 0.3448, -2.0734, 9.7710, 0.6297, -2.5092, 9.2539, 0.6297, -2.5092, 9.2539, -0.7087, -2.6960, 9.7639, -0.8260, -2.8396, 9.2802, -0.9745, -2.6600, 9.3185, -1.1947, -2.6026, 9.3449, -1.3552, -2.4948, 9.6010, -1.3743, -2.4350, 9.6250, -1.6999, -2.3392, 9.5172, -1.5874, -2.3105, 9.3281, -3.6800, -2.3703, 9.3496, -3.9242, -2.2291, 9.3305, -3.1197, -2.0950, 8.8445, -0.1676, -1.9370, 9.7399, 0.4932, -1.6975, 9.5436, -1.2474, -1.1971, 8.6625, -0.4980, -0.8069, 11.0927, 0.5722, -1.3121, 9.4430, 0.7350, -1.6113, 10.2188, 0.9146, -1.8005, 9.2323, 0.1149, -1.7957, 9.9745, -0.7183, -1.8963, 9.4550, 0.9194, -1.9274, 9.4837, -6.8548, 1.9202, 6.8069, 2.4278, -7.6521, 10.9323, 0.1844, -7.4199, 9.8884, 0.1844, -7.4199, 9.8884, -0.8572, -4.4534, 8.8852, -1.6377, -3.2538, 9.2802, 1.3935, -5.1477, 10.1972, 3.4861, -5.0519, 9.6178, 2.4900, -4.5707, 9.4430, -2.3320, -3.6513, 9.5747, -4.2235, -3.3544, 8.8564, -6.2467, -2.5595, 9.1796, -5.7918, -1.5467, 9.1150, -5.9450, -0.8093, 8.1022, -7.9083, 1.0080, 8.0663, -8.4925, 0.2849, 9.8907, 1.3264, -2.1405, 10.5252, 1.3264, -2.1405, 10.5252, -4.1660, 0.1293, 9.4143, -5.8971, 1.7718, 9.3592, -4.6784, 0.6369, 9.4287, -1.5323, -1.5347, 9.4981, -0.7159, -1.3312, 10.2834, 0.0670, 0.5555, 9.0432, 1.2067, -0.7303, 10.7311, 2.3536, -1.6425, 10.7814, 0.9840, 0.8619, 9.4191, -1.8963, 0.2921, 9.6058, -1.8963, 0.2921, 9.6058, -2.1788, -0.7853, 9.4646, -1.4222, -1.1947, 9.4789, -1.1301, -0.0431, 9.4550, -1.0487, -0.0646, 9.5220, -1.0774, -0.0072, 9.4382, -1.0798, -0.0575, 9.4670, -1.0487, -0.0239, 9.4957, -1.0415, -0.0503, 9.5220, -1.0607, -0.0263, 9.4957, -1.0559, -0.0359, 9.4837, -1.0439, -0.0287, 9.4957, -1.0487, -0.0383, 9.4765, -1.0583, -0.0407, 9.4741, -1.0487, -0.0646, 9.4909, -1.1636, 0.0311, 9.5699, -1.2594, 0.2322, 9.1150, -1.0008, -0.0431, 9.6705, -0.5770, -0.8188, 9.4287, -0.5770, -0.8188, 9.4287, -0.6081, -0.4022, 10.8604, -0.2227, -0.3567, 9.9099, -0.5938, 0.3783, 9.5053, -0.9242, 0.6848, 10.0200, -1.3456, -0.3472, 12.8094, -1.3456, -0.3472, 12.8094, 0.8595, -0.4382, 9.9458, 1.2929, 0.6680, 11.5691, 2.0303, 0.7901, 8.5715, 0.9218, 0.6105, 11.0376, -0.0886, -1.6975, 9.5986, -0.2155, -1.1804, 9.7088, -0.4310, -0.8021, 9.4909, -0.9386, -0.8404, 9.6178, -1.4821, -1.6377, 9.2706, -1.8101, -1.8795, 9.8165, -2.0782, -1.8268, 9.5029, -2.2003, -1.7718, 9.2395 };
```
