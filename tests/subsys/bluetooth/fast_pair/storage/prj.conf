## CMakeLists.txt
```
#
# Copyright (c) 2022 Nordic Semiconductor ASA
#
# SPDX-License-Identifier: LicenseRef-Nordic-5-Clause
#

cmake_minimum_required(VERSION 3.20.0)

find_package(Zephyr REQUIRED HINTS $ENV{ZEPHYR_BASE})
project("Fast Pair storage unit test")

# Add test sources
target_sources(app PRIVATE
	       src/main.c
	       src/settings_mock.c
)
target_include_directories(app PRIVATE include)

# Add needed Fast Pair storage as part of the test (app target)
get_filename_component(NRF_BASE ${CMAKE_CURRENT_LIST_DIR}/../../../../../../ DIRECTORY)
set(NCS_FAST_PAIR_BASE ${NRF_BASE}/subsys/bluetooth/services/fast_pair)

add_subdirectory(${NCS_FAST_PAIR_BASE}/fp_storage fp_storage)
target_link_libraries(app PRIVATE fp_storage)
```

## Kconfig
```
#
# Copyright (c) 2022 Nordic Semiconductor
#
# SPDX-License-Identifier: LicenseRef-Nordic-5-Clause
#

menu "Test configuration"
rsource "../../../../../subsys/bluetooth/services/fast_pair/fp_storage/Kconfig.fp_storage"
endmenu

source "Kconfig.zephyr"
```

## prj.conf
```kconfig
#
# Copyright (c) 2022 Nordic Semiconductor ASA
#
# SPDX-License-Identifier: LicenseRef-Nordic-5-Clause
#

CONFIG_ZTEST=y
CONFIG_SETTINGS=y
CONFIG_SETTINGS_CUSTOM=y
CONFIG_HEAP_MEM_POOL_SIZE=1024

# Prevent flooding logs with information about erasing the oldest Account Key.
CONFIG_FP_STORAGE_LOG_LEVEL_WRN=y
```

## src/main.c
```c
/*
 * Copyright (c) 2022 Nordic Semiconductor ASA
 *
 * SPDX-License-Identifier: LicenseRef-Nordic-5-Clause
 */

#include "api_test.h"
#include "corrupted_data_test.h"


void test_main(void)
{
	api_test_run();
	corrupted_data_test_run();
}
```

## include/api_test.h
```c
/*
 * Copyright (c) 2022 Nordic Semiconductor ASA
 *
 * SPDX-License-Identifier: LicenseRef-Nordic-5-Clause
 */

#ifndef _API_TEST_H_
#define _API_TEST_H_

/**
 * @defgroup fp_storage_test_api_test Fast Pair storage API unit test
 * @brief Unit test of the Fast Pair storage API
 *
 * @{
 */

#ifdef __cplusplus
extern "C" {
#endif

/** Start test suite for Fast Pair storage API.
 *
 *  The test suite checks correctness of the Fast Pair storage API implementation.
 */
void api_test_run(void);

#ifdef __cplusplus
}
#endif

/**
 * @}
 */

#endif /* _API_TEST_H_ */
```

## include/common_utils.h
```c
/*
 * Copyright (c) 2022 Nordic Semiconductor ASA
 *
 * SPDX-License-Identifier: LicenseRef-Nordic-5-Clause
 */

#ifndef _COMMON_UTILS_H_
#define _COMMON_UTILS_H_

/**
 * @defgroup fp_storage_test_common_utils Fast Pair storage unit test common utilities
 * @brief Common utilities of the Fast Pair storage unit test
 *
 * @{
 */

#ifdef __cplusplus
extern "C" {
#endif

/** Generate mocked Account Key data.
 *
 * @param[in] key_id 		ID used to generate the Account Key.
 * @param[out] account_key 	128-bit (16-byte) buffer used to store generated Account Key.
 */
void generate_account_key(uint8_t key_id, uint8_t *account_key);

/** Check if Account Key data was generated from provided ID.
 *
 * @param[in] key_id		ID to be verified.
 * @param[in] account_key	128-bit (16-byte) Account Key data to be verified.
 *
 * @retval true If the Account Key data was generated from provided ID.
 * @retval false If the Account Key data was not generated from provided ID.
 */
bool check_account_key_id(uint8_t key_id, const uint8_t *account_key);

/** Validate that Fast Pair storage data is not loaded.
 *
 * The function uses Fast Pair storage API to validate that the data is not loaded from settings.
 * Ztest asserts are used to signalize error.
 */
void validate_fp_storage_unloaded(void);

/** Validate the loaded Fast Pair storage data.
 *
 * The function uses Fast Pair storage API to validate that the data is valid.
 * The function assumes that @ref generate_account_key was used to generate subsequent Account Keys.
 * Ztest asserts are used to signalize error.
 *
 * @param[in] first_id		ID assigned to the first generated Account Key.
 * @param[in] stored_cnt	Number of stored keys.
 */
void validate_fp_storage_loaded(uint8_t first_id, uint8_t stored_cnt);

#ifdef __cplusplus
}
#endif

/**
 * @}
 */

#endif /* _COMMON_UTILS_H_ */
```

## include/corrupted_data_test.h
```c
/*
 * Copyright (c) 2022 Nordic Semiconductor ASA
 *
 * SPDX-License-Identifier: LicenseRef-Nordic-5-Clause
 */

#ifndef _CORRUPTED_DATA_TEST_H_
#define _CORRUPTED_DATA_TEST_H_

/**
 * @defgroup fp_storage_test_corrupted_data_test Fast Pair storage corrupted data unit test
 * @brief Unit test of handling corrupted data in the Fast Pair storage
 *
 * @{
 */

#ifdef __cplusplus
extern "C" {
#endif

/** Start test suite of corrupted data handling in the Fast Pair storage.
 *
 * The test suite verifies handling of corrupted settings data in the Fast Pair storage module.
 */
void corrupted_data_test_run(void);

#ifdef __cplusplus
}
#endif

/**
 * @}
 */

#endif /* _CORRUPTED_DATA_TEST_H_ */
```

## src/api_test.c
```c
/*
 * Copyright (c) 2022 Nordic Semiconductor ASA
 *
 * SPDX-License-Identifier: LicenseRef-Nordic-5-Clause
 */

#include <ztest.h>
#include <zephyr/settings/settings.h>

#include "fp_storage.h"
#include "fp_crypto.h"

#include "storage_mock.h"
#include "common_utils.h"

#define ACCOUNT_KEY_MAX_CNT	CONFIG_BT_FAST_PAIR_STORAGE_ACCOUNT_KEY_MAX
#define ACCOUNT_KEY_LEN		FP_CRYPTO_ACCOUNT_KEY_LEN


static bool account_key_find_cb(const uint8_t *account_key, void *context)
{
	uint8_t *key_id = context;

	return check_account_key_id(*key_id, account_key);
}

static void reload_keys_from_storage(void)
{
	int err;

	fp_storage_ram_clear();
	validate_fp_storage_unloaded();
	err = settings_load();

	zassert_ok(err, "Failed to load settings");
}

static void setup_fn(void)
{
	int err;

	validate_fp_storage_unloaded();

	/* Load empty settings before the test to initialize fp_storage. */
	err = settings_load();

	zassert_ok(err, "Settings load failed");
}

static void teardown_fn(void)
{
	fp_storage_ram_clear();
	storage_mock_clear();
	validate_fp_storage_unloaded();
}

static void test_unloaded(void)
{
	static const uint8_t test_key_id = 0;

	int err;
	uint8_t account_key[ACCOUNT_KEY_LEN];

	validate_fp_storage_unloaded();
	generate_account_key(test_key_id, account_key);

	err = fp_storage_account_key_save(account_key);
	zassert_equal(err, -ENODATA, "Expected error before settings load");
}

static void test_one_key(void)
{
	static const uint8_t test_key_id = 5;

	int err;
	uint8_t account_key[ACCOUNT_KEY_LEN];

	generate_account_key(test_key_id, account_key);
	err = fp_storage_account_key_save(account_key);
	zassert_ok(err, "Unexpected error during Account Key save");

	uint8_t read_keys[ACCOUNT_KEY_MAX_CNT][ACCOUNT_KEY_LEN];
	size_t read_cnt = ACCOUNT_KEY_MAX_CNT;

	zassert_equal(fp_storage_account_key_count(), 1, "Invalid Account Key count");
	err = fp_storage_account_keys_get(read_keys, &read_cnt);
	zassert_ok(err, "Getting Account Keys failed");
	zassert_equal(read_cnt, 1, "Invalid Account Key count");
	zassert_true(check_account_key_id(test_key_id, read_keys[0]), "Invalid key on read");

	/* Reload keys from storage and validate them again. */
	reload_keys_from_storage();
	memset(read_keys, 0, sizeof(read_keys));
	read_cnt = ACCOUNT_KEY_MAX_CNT;

	zassert_equal(fp_storage_account_key_count(), 1, "Invalid Account Key count");
	err = fp_storage_account_keys_get(read_keys, &read_cnt);
	zassert_ok(err, "Getting Account Keys failed");
	zassert_equal(read_cnt, 1, "Invalid Account Key count");
	zassert_true(check_account_key_id(test_key_id, read_keys[0]), "Invalid key on read");
}

static void test_duplicate(void)
{
	static const uint8_t test_key_id = 3;

	int err;
	uint8_t account_key[ACCOUNT_KEY_LEN];

	generate_account_key(test_key_id, account_key);
	err = fp_storage_account_key_save(account_key);
	zassert_ok(err, "Unexpected error during Account Key save");

	/* Try to add key duplicate. */
	err = fp_storage_account_key_save(account_key);
	zassert_ok(err, "Unexpected error during Account Key save");

	uint8_t read_keys[ACCOUNT_KEY_MAX_CNT][ACCOUNT_KEY_LEN];
	size_t read_cnt = ACCOUNT_KEY_MAX_CNT;

	zassert_equal(fp_storage_account_key_count(), 1, "Invalid Account Key count");
	err = fp_storage_account_keys_get(read_keys, &read_cnt);
	zassert_ok(err, "Getting Account Keys failed");
	zassert_equal(read_cnt, 1, "Invalid Account Key count");
	zassert_true(check_account_key_id(test_key_id, read_keys[0]), "Invalid key on read");

	/* Reload keys from storage and validate them again. */
	reload_keys_from_storage();
	memset(read_keys, 0, sizeof(read_keys));
	read_cnt = ACCOUNT_KEY_MAX_CNT;

	zassert_equal(fp_storage_account_key_count(), 1, "Invalid Account Key count");
	err = fp_storage_account_keys_get(read_keys, &read_cnt);
	zassert_ok(err, "Getting Account Keys failed");
	zassert_equal(read_cnt, 1, "Invalid Account Key count");
	zassert_true(check_account_key_id(test_key_id, read_keys[0]), "Invalid key on read");
}

static void generate_and_store_keys(uint8_t first_id, uint8_t gen_count)
{
	int err;
	uint8_t account_key[ACCOUNT_KEY_LEN];

	for (uint8_t i = first_id; i < (first_id + gen_count); i++) {
		generate_account_key(i, account_key);

		err = fp_storage_account_key_save(account_key);
		zassert_ok(err, "Failed to store Account Key");
	}
}

static void test_invalid_calls(void)
{
	static const uint8_t test_key_cnt = 3;

	int err;
	uint8_t found_key[ACCOUNT_KEY_LEN];
	uint8_t read_keys[ACCOUNT_KEY_MAX_CNT][ACCOUNT_KEY_LEN];

	generate_and_store_keys(0, test_key_cnt);

	for (size_t read_cnt = 0; read_cnt <= ACCOUNT_KEY_MAX_CNT; read_cnt++) {
		size_t read_cnt_ret = read_cnt;

		err = fp_storage_account_keys_get(read_keys, &read_cnt_ret);

		if (read_cnt < test_key_cnt) {
			zassert_equal(err, -EINVAL, "Expected error when array is too small");
		} else {
			zassert_ok(err, "Unexpected error during Account Keys get");
			zassert_equal(read_cnt_ret, test_key_cnt, "Inavlid account key count");

			for (size_t i = 0; i < read_cnt_ret; i++) {
				zassert_true(check_account_key_id(i, read_keys[i]),
					     "Invalid key on read");
			}
		}
	}

	uint8_t key_id = 0;

	err = fp_storage_account_key_find(found_key, NULL, &key_id);
	zassert_equal(err, -EINVAL, "Expected error when callback is NULL");
}

static void test_find(void)
{
	static const size_t test_key_cnt = 3;
	int err = 0;

	generate_and_store_keys(0, test_key_cnt);

	for (uint8_t key_id = 0; key_id < test_key_cnt; key_id++) {
		uint8_t account_key[ACCOUNT_KEY_LEN];
		uint8_t prev_key_id = key_id;

		err = fp_storage_account_key_find(account_key, account_key_find_cb, &key_id);
		zassert_ok(err, "Failed to find Account Key");
		zassert_equal(prev_key_id, key_id, "Context should not be modified");
		zassert_true(check_account_key_id(key_id, account_key), "Found wrong Account Key");
	}

	for (uint8_t key_id = 0; key_id < (test_key_cnt + 1); key_id++) {
		uint8_t prev_key_id = key_id;

		err = fp_storage_account_key_find(NULL, account_key_find_cb, &key_id);
		zassert_equal(prev_key_id, key_id, "Context should not be modified");
		if (err) {
			zassert_equal(key_id, test_key_cnt, "Failed to find Acount Key");
			break;
		}
	}

	zassert_equal(err, -ESRCH, "Expected error when key cannot be found");
}

static void test_loop(void)
{
	static const uint8_t first_key_id = 0;

	for (uint8_t i = 1; i < UCHAR_MAX; i++) {
		setup_fn();

		generate_and_store_keys(first_key_id, i);
		validate_fp_storage_loaded(first_key_id, i);

		/* Reload keys from storage and validate them again. */
		reload_keys_from_storage();
		validate_fp_storage_loaded(first_key_id, i);

		teardown_fn();
	}
}

void api_test_run(void)
{
	ztest_test_suite(fast_pair_storage_api_tests,
			 ztest_unit_test(test_unloaded),
			 ztest_unit_test_setup_teardown(test_one_key, setup_fn, teardown_fn),
			 ztest_unit_test_setup_teardown(test_duplicate, setup_fn, teardown_fn),
			 ztest_unit_test_setup_teardown(test_invalid_calls, setup_fn, teardown_fn),
			 ztest_unit_test_setup_teardown(test_find, setup_fn, teardown_fn),
			 ztest_unit_test(test_loop)
			 );

	ztest_run_test_suite(fast_pair_storage_api_tests);
}
```

## src/common_utils.c
```c
/*
 * Copyright (c) 2022 Nordic Semiconductor ASA
 *
 * SPDX-License-Identifier: LicenseRef-Nordic-5-Clause
 */

#include <ztest.h>

#include "fp_storage.h"
#include "fp_crypto.h"

#define ACCOUNT_KEY_MAX_CNT	CONFIG_BT_FAST_PAIR_STORAGE_ACCOUNT_KEY_MAX
#define ACCOUNT_KEY_LEN		FP_CRYPTO_ACCOUNT_KEY_LEN


void generate_account_key(uint8_t key_id, uint8_t *account_key)
{
        memset(account_key, key_id, ACCOUNT_KEY_LEN);
}

bool check_account_key_id(uint8_t key_id, const uint8_t *account_key)
{
	if (account_key[0] != key_id) {
		return false;
	}

	for (size_t i = 1; i < ACCOUNT_KEY_LEN; i++) {
		zassert_equal(account_key[i], key_id, "Invalid Account Key");
	}

	return true;
}

static bool account_key_find_cb(const uint8_t *account_key, void *context)
{
	uint8_t *key_id = context;

	return check_account_key_id(*key_id, account_key);
}

void validate_fp_storage_unloaded(void)
{
	int err;
	uint8_t all_keys[ACCOUNT_KEY_MAX_CNT][ACCOUNT_KEY_LEN];
	size_t key_count = ACCOUNT_KEY_MAX_CNT;
	uint8_t key_id = 0;

	err = fp_storage_account_key_count();
	zassert_equal(err, -ENODATA, "Expected error before settings load");

	err = fp_storage_account_keys_get(all_keys, &key_count);
	zassert_equal(err, -ENODATA, "Expected error before settings load");

	err = fp_storage_account_key_find(all_keys[0], account_key_find_cb, &key_id);
	zassert_equal(err, -ENODATA, "Expected error before settings load");
}

void validate_fp_storage_loaded(uint8_t first_id, uint8_t stored_cnt)
{
	int res;

	int key_cnt;
	uint8_t read_keys[ACCOUNT_KEY_MAX_CNT][ACCOUNT_KEY_LEN];
	size_t read_cnt = ACCOUNT_KEY_MAX_CNT;

	key_cnt = fp_storage_account_key_count();

	res = fp_storage_account_keys_get(read_keys, &read_cnt);
	zassert_ok(res, "Getting Account Keys failed");
	zassert_equal(key_cnt, read_cnt, "Invalid key count");
	zassert_equal(key_cnt, MIN(stored_cnt, ACCOUNT_KEY_MAX_CNT), "Invalid key count");

	size_t key_id_min = (stored_cnt < ACCOUNT_KEY_MAX_CNT) ?
			    (0) : (stored_cnt - ACCOUNT_KEY_MAX_CNT);
	size_t key_id_max = stored_cnt - 1;

	key_id_min += first_id;
	key_id_max += first_id;

	for (size_t i = key_id_min; i <= key_id_max; i++) {
		bool found = false;

		for (size_t j = 0; j < read_cnt; j++) {
			if (found) {
				zassert_false(check_account_key_id(i, read_keys[j]),
					      "Key duplicate found");
			}

			if (check_account_key_id(i, read_keys[j])) {
				found = true;
			}
		}

		zassert_true(found, "Key dropped by the Fast Pair storage");
	}
}
```

## src/corrupted_data_test.c
```c
/*
 * Copyright (c) 2022 Nordic Semiconductor ASA
 *
 * SPDX-License-Identifier: LicenseRef-Nordic-5-Clause
 */

#include <ztest.h>
#include <zephyr/settings/settings.h>

#include "fp_storage.h"
#include "fp_storage_priv.h"

#include "storage_mock.h"
#include "common_utils.h"


static void setup_fn(void)
{
	/* Make sure that settings are not yet loaded. Settings will be populated with data and
	 * loaded by the unit test.
	 */
	validate_fp_storage_unloaded();
}

static void teardown_fn(void)
{
	int err = settings_load();

	zassert_not_equal(err, 0, "Expected error in settings load");
	validate_fp_storage_unloaded();

	fp_storage_ram_clear();
	storage_mock_clear();
}

/* Self test is done to ensure that the test method is valid. */
static void self_test_teardown_fn(void)
{
	fp_storage_ram_clear();
	storage_mock_clear();
	validate_fp_storage_unloaded();
}

static void test_wrong_settings_key(void)
{
	int err;
	uint8_t key_id = ACCOUNT_KEY_MIN_ID;
	struct account_key_data data;

	data.account_key_id = key_id;
	generate_account_key(key_id, data.account_key);

	err = settings_save_one(SETTINGS_AK_SUBTREE_NAME SETTINGS_NAME_CONNECTOR "not_account_key",
				&data, sizeof(data));
	zassert_ok(err, "Unexpected error in settings save");
}

static void test_wrong_data_len(void)
{
	int err;
	uint8_t key_id = ACCOUNT_KEY_MIN_ID;
	char settings_key[SETTINGS_AK_NAME_MAX_SIZE] = SETTINGS_AK_FULL_PREFIX;
	struct account_key_data data;

	zassert_true(('0' + account_key_id_to_idx(key_id)) <= '9', "Key index out of range");
	settings_key[ARRAY_SIZE(settings_key) - 2] = ('0' + account_key_id_to_idx(key_id));
	settings_key[ARRAY_SIZE(settings_key) - 1] = '\0';

	data.account_key_id = key_id;
	generate_account_key(key_id, data.account_key);

	err = settings_save_one(settings_key, &data, sizeof(data) - 1);
	zassert_ok(err, "Unexpected error in settings save");
}

static void test_inconsistent_key_id(void)
{
	int err;
	uint8_t key_id = ACCOUNT_KEY_MIN_ID;
	char settings_key[SETTINGS_AK_NAME_MAX_SIZE] = SETTINGS_AK_FULL_PREFIX;
	struct account_key_data data;

	zassert_true(('0' + account_key_id_to_idx(key_id)) <= '9', "Key index out of range");
	settings_key[ARRAY_SIZE(settings_key) - 2] = ('0' + account_key_id_to_idx(key_id));
	settings_key[ARRAY_SIZE(settings_key) - 1] = '\0';

	data.account_key_id = next_account_key_id(key_id);
	generate_account_key(next_account_key_id(key_id), data.account_key);

	err = settings_save_one(settings_key, &data, sizeof(data));
	zassert_ok(err, "Unexpected error in settings save");
}

static void store_key(uint8_t key_id)
{
	int err;
	char settings_key[SETTINGS_AK_NAME_MAX_SIZE] = SETTINGS_AK_FULL_PREFIX;
	struct account_key_data data;

	zassert_true(('0' + account_key_id_to_idx(key_id)) <= '9', "Key index out of range");
	settings_key[ARRAY_SIZE(settings_key) - 2] = ('0' + account_key_id_to_idx(key_id));
	settings_key[ARRAY_SIZE(settings_key) - 1] = '\0';

	data.account_key_id = key_id;
	generate_account_key(key_id, data.account_key);

	err = settings_save_one(settings_key, &data, sizeof(data));
	zassert_ok(err, "Unexpected error in settings save");
}

static void self_test(void)
{
	int err;
	uint8_t key_id = ACCOUNT_KEY_MIN_ID;
	uint8_t key_cnt = 0;

	store_key(key_id);
	key_cnt++;
	key_id = next_account_key_id(key_id);

	store_key(key_id);
	key_cnt++;
	key_id = next_account_key_id(key_id);

	store_key(key_id);
	key_cnt++;

	err = settings_load();
	zassert_ok(err, "Unexpected error in settings load");

	validate_fp_storage_loaded(ACCOUNT_KEY_MIN_ID, key_cnt);
}

static void self_test_rollover(void)
{
	int err;
	uint8_t key_id = ACCOUNT_KEY_MIN_ID;
	uint8_t key_cnt = 0;

	for (size_t i = 0; i < ACCOUNT_KEY_CNT; i++) {
		store_key(key_id);
		key_cnt++;
		key_id = next_account_key_id(key_id);
	}

	store_key(key_id);
	key_cnt++;
	key_id = next_account_key_id(key_id);

	store_key(key_id);
	key_cnt++;

	err = settings_load();
	zassert_ok(err, "Unexpected error in settings load");

	validate_fp_storage_loaded(ACCOUNT_KEY_MIN_ID, key_cnt);
}

static void test_drop_first_key(void)
{
	store_key(next_account_key_id(ACCOUNT_KEY_MIN_ID));
}

static void test_drop_key(void)
{
	uint8_t key_id = ACCOUNT_KEY_MIN_ID;

	store_key(key_id);

	key_id = next_account_key_id(key_id);
	store_key(key_id);

	key_id = next_account_key_id(key_id);
	key_id = next_account_key_id(key_id);
	store_key(key_id);
}

static void test_drop_keys(void)
{
	uint8_t key_id = ACCOUNT_KEY_MIN_ID;

	store_key(key_id);

	for (size_t i = 0; i < ACCOUNT_KEY_CNT; i++) {
		key_id = next_account_key_id(key_id);
	}

	store_key(key_id);
}

static void test_drop_rollover(void)
{
	uint8_t key_id = ACCOUNT_KEY_MIN_ID;

	for (size_t i = 0; i < ACCOUNT_KEY_CNT; i++) {
		store_key(key_id);
		key_id = next_account_key_id(key_id);
	}

	zassert_equal(account_key_id_to_idx(ACCOUNT_KEY_MIN_ID), account_key_id_to_idx(key_id),
		      "Test should drop key exactly after rollover");
	key_id = next_account_key_id(key_id);
	store_key(key_id);
}

void corrupted_data_test_run(void)
{
	ztest_test_suite(fast_pair_storage_courrupted_data_tests,
			 ztest_unit_test_setup_teardown(self_test, setup_fn, self_test_teardown_fn),
			 ztest_unit_test_setup_teardown(self_test_rollover, setup_fn,
							self_test_teardown_fn),
			 ztest_unit_test_setup_teardown(test_wrong_settings_key, setup_fn,
							teardown_fn),
			 ztest_unit_test_setup_teardown(test_wrong_data_len, setup_fn, teardown_fn),
			 ztest_unit_test_setup_teardown(test_inconsistent_key_id, setup_fn,
							teardown_fn),
			 ztest_unit_test_setup_teardown(test_drop_first_key, setup_fn, teardown_fn),
			 ztest_unit_test_setup_teardown(test_drop_key, setup_fn, teardown_fn),
			 ztest_unit_test_setup_teardown(test_drop_keys, setup_fn, teardown_fn),
			 ztest_unit_test_setup_teardown(test_drop_rollover, setup_fn, teardown_fn)
			 );

	ztest_run_test_suite(fast_pair_storage_courrupted_data_tests);
}
```
