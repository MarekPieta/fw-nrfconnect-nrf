## subsys/bluetooth/services/fast_pair/fp_storage/Kconfig.fp_storage
```kconfig
#
# Copyright (c) 2022 Nordic Semiconductor ASA
#
# SPDX-License-Identifier: LicenseRef-Nordic-5-Clause
#

config BT_FAST_PAIR_STORAGE
	bool
	default y
	select SETTINGS
	help
	  Add Fast Pair storage source files.

if BT_FAST_PAIR_STORAGE

config BT_FAST_PAIR_STORAGE_ACCOUNT_KEY_MAX
	int "Maximum number of stored Account Keys"
	range 5 10
	default 5
	help
	  Maximum number of stored account keys. According to Fast Pair specification, it should be
	  at least equal to 5. It can not be larger than 10, because then Account Key Filter length
	  would not fit in the "field length and type" data field specified in the non-discoverable
	  advertising packet.

endif # BT_FAST_PAIR_STORAGE

module = FP_STORAGE
module-str = Fast Pair storage library
source "${ZEPHYR_BASE}/subsys/logging/Kconfig.template.log_config"
```

## subsys/caf/Kconfig
```kconfig
#
# Copyright (c) 2021 Nordic Semiconductor ASA
#
# SPDX-License-Identifier: LicenseRef-Nordic-5-Clause
#

menuconfig CAF
	bool "Common Application Framework"
	select EVENT_MANAGER
	select CAF_MODULE_STATE_EVENTS
	select CAF_PM_EVENTS
	help
	  Enable usage of Common Application Framework.

if CAF
rsource "events/Kconfig"
rsource "modules/Kconfig"
endif # CAF
```

## subsys/caf/events/Kconfig
```kconfig
#
# Copyright (c) 2021 Nordic Semiconductor ASA
#
# SPDX-License-Identifier: LicenseRef-Nordic-5-Clause
#

menu "Event options"

config CAF_MODULE_STATE_EVENTS
	bool "Enable module state events"
	help
	  Enable support for module state events.

config CAF_INIT_LOG_MODULE_STATE_EVENTS
	bool "Log module state events"
	depends on CAF_MODULE_STATE_EVENTS
	depends on LOG
	default y

config CAF_PM_EVENTS
	bool "Enable power management events"
	help
	  Enable support for power management events.

config CAF_INIT_LOG_POWER_DOWN_EVENTS
	bool "Log power down events"
	depends on CAF_PM_EVENTS
	depends on LOG
	default y

config CAF_INIT_LOG_WAKE_UP_EVENTS
	bool "Log wake up events"
	depends on CAF_PM_EVENTS
	depends on LOG
	default y

config CAF_BUTTON_EVENTS
	bool "Enable button events"
	help
	  Enable support for button events.

config CAF_INIT_LOG_BUTTON_EVENTS
	bool "Log button events"
	depends on CAF_BUTTON_EVENTS
	depends on LOG
	default y

config CAF_LED_EVENTS
	bool "Enable LED events"
	help
	  Enable support for LED event.

config CAF_INIT_LOG_LED_EVENTS
	bool "Log LED events"
	depends on CAF_LED_EVENTS
	depends on LOG
	default y
	help
	  Log LED events used to change LED operating mode and color.

config CAF_INIT_LOG_LED_READY_EVENTS
	bool "Log LED ready event"
	depends on CAF_LED_EVENTS
	depends on LOG
	default y
	help
	  Log LED events used to notify that LED is ready for next stream
	  effect.

endmenu
```
