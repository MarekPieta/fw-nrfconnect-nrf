## applications/edge_impulse/sample.yaml
```yaml
sample:
  name: Edge Impulse
  description: Edge Impulse application reference design
tests:
  applications.edge_impulse.zdebug:
    build_only: true
    build_on_all: true
    platform_allow: nrf52840dk_nrf52840
    tags: ci_build
```

## applications/edge_impulse/src/modules/Kconfig
```kconfig
#
# Copyright (c) 2021 Nordic Semiconductor
#
# SPDX-License-Identifier: LicenseRef-Nordic-5-Clause
#

rsource "Kconfig.ei_data_forwarder"
rsource "Kconfig.ei_ml_runner"
rsource "Kconfig.sensor_sampler"
rsource "Kconfig.sensor_sim_ctrl"

rsource "Kconfig.click_detector"
```

## applications/edge_impulse/src/modules/Kconfig.ei_data_forwarder
```kconfig
#
# Copyright (c) 2021 Nordic Semiconductor
#
# SPDX-License-Identifier: LicenseRef-Nordic-5-Clause
#

menu "Edge Impulse data forwarder"

config EI_APP_DATA_FORWARDER_ENABLE
	bool "Enable data forwarder"
	depends on UART_ASYNC_API

if EI_APP_DATA_FORWARDER_ENABLE

config EI_APP_DATA_FORWARDER_BUF_SIZE
	int "Buffer size"
	default 64
	range 6 4096
	help
	  Size of the buffer used to temporarily store forwarded data.
	  The buffer must be big enough to store a single line of forwarded data.

config EI_APP_DATA_FORWARDER_UART_DEV
	string "UART device name"
	default "UART_0"
	help
	  Name of UART device that is used to forward data.

module = EI_APP_DATA_FORWARDER
module-str = EI app data forwarder
source "subsys/logging/Kconfig.template.log_config"

endif # EI_APP_DATA_FORWARDER_ENABLE

endmenu
```

## applications/edge_impulse/src/modules/Kconfig.ei_ml_runner
```kconfig
#
# Copyright (c) 2021 Nordic Semiconductor
#
# SPDX-License-Identifier: LicenseRef-Nordic-5-Clause
#

menu "Edge Impulse runner"

config EI_APP_ML_RUNNER
	bool "Edge Impulse machine learning model runner"
	depends on EI_WRAPPER

if EI_APP_ML_RUNNER

config EI_APP_ML_RUNNER_WINDOW_SHIFT
	int "Prediction window shift [windows]"
	default 1
	help
	  Number of windows the prediction window is shifted between predictions.

config EI_APP_ML_RUNNER_FRAME_SHIFT
	int "Prediction window shift [frames]"
	default 0
	help
	  Number of frames the prediction window is shifted between predictions.

module = EI_APP_ML_RUNNER
module-str = EI app machine learning model runner
source "subsys/logging/Kconfig.template.log_config"

endif # EI_APP_ML_RUNNER

endmenu
```

## applications/edge_impulse/src/modules/Kconfig.sensor_sampler
```kconfig
#
# Copyright (c) 2021 Nordic Semiconductor
#
# SPDX-License-Identifier: LicenseRef-Nordic-5-Clause
#

menu "Sensor sampler"

config EI_APP_SENSOR_SAMPLER_ENABLE
	bool "Enable sensor sampler"
	depends on SENSOR

if EI_APP_SENSOR_SAMPLER_ENABLE

module = EI_APP_SENSOR_SAMPLER
module-str = EI app sensor sampler
source "subsys/logging/Kconfig.template.log_config"

endif # EI_APP_SENSOR_SAMPLER_ENABLE

endmenu
```

## applications/edge_impulse/src/modules/Kconfig.sensor_sim_ctrl
```kconfig
#
# Copyright (c) 2021 Nordic Semiconductor
#
# SPDX-License-Identifier: LicenseRef-Nordic-5-Clause
#

menu "Sensor sim controller"

config EI_APP_SENSOR_SIM_CTRL_ENABLE
	bool "Enable simulated sensor controller"
	depends on SENSOR_SIM_ACCEL_WAVE
	default y

if EI_APP_SENSOR_SIM_CTRL_ENABLE

module = EI_APP_SENSOR_SIM_CTRL
module-str = EI app sensor sim controller
source "subsys/logging/Kconfig.template.log_config"

endif # EI_APP_SENSOR_SIM_CTRL_ENABLE

endmenu
```

## applications/nrf_desktop/Kconfig.defaults
```kconfig
#
# Copyright (c) 2022 Nordic Semiconductor ASA
#
# SPDX-License-Identifier: LicenseRef-Nordic-5-Clause
#

config DESKTOP_COMMON_MODULES
	bool
	default y
	select CAF_SETTINGS_LOADER
	select CAF_POWER_MANAGER

config DESKTOP_HID_PERIPHERAL_MODULES
	bool
	default y if DESKTOP_ROLE_HID_PERIPHERAL
	select CAF_BLE_ADV
```

## applications/nrf_desktop/src/modules/Kconfig.caf_power_manager
```kconfig
#
# Copyright (c) 2022 Nordic Semiconductor ASA
#
# SPDX-License-Identifier: LicenseRef-Nordic-5-Clause
#

# nRF Desktop specific configuration overlay for CAF power manager module.

config DESKTOP_POWER_MANAGER
	bool
	default y
	select CAF_POWER_MANAGER
	select CAF_PM_EVENTS
	select PM_POLICY_CUSTOM
	imply CAF_POWER_MANAGER_STAY_ON if DESKTOP_ROLE_HID_DONGLE
```

## applications/nrf_desktop/src/modules/Kconfig.caf_power_manager.default
```kconfig
#
# Copyright (c) 2022 Nordic Semiconductor ASA
#
# SPDX-License-Identifier: LicenseRef-Nordic-5-Clause
#

# nRF Desktop specific configuration overlay for CAF power manager module.

if CAF_POWER_MANAGER

config DESKTOP_POWER_MANAGER
	bool
	default y
	select CAF_PM_EVENTS
	select PM_POLICY_CUSTOM
	imply CAF_POWER_MANAGER_STAY_ON if DESKTOP_ROLE_HID_DONGLE

endif # CAF_POWER_MANAGER
```

## applications/nrf_desktop/src/modules/Kconfig.cpi_state
```kconfig
#
# Copyright (c) 2019 Nordic Semiconductor
#
# SPDX-License-Identifier: LicenseRef-BSD-5-Clause-Nordic
#

menu "CPI State"

config DESKTOP_CPI_STATE_ENABLE
	bool "Enable changing sensor CPI with buttons"
	depends on !DESKTOP_MOTION_NONE
	depends on !DESKTOP_BUTTONS_NONE

if DESKTOP_CPI_STATE_ENABLE

config DESKTOP_CPI_STATE_TOGGLE_UP_BUTTON_ID
	hex "ID of button that toggles CPI upwards"
	default 0x0000

config DESKTOP_CPI_STATE_TOGGLE_DOWN_BUTTON_ID
	hex "ID of button that toggles CPI downwards"
	default 0x0000

config DESKTOP_CPI_STATE_NUMBER_OF_STEPS
	int "Number of CPI steps"
	default 5
	range 1 100

config DESKTOP_CPI_STATE_LOW_VALUE
	int "Lowest CPI value in CPI state"
	default 100
	range 100 5000

config DESKTOP_CPI_STATE_HIGH_VALUE
	int "Highest CPI value in CPI state"
	default 5000
	range 100 5000

module = DESKTOP_CPI_STATE
module-str = CPI state
source "subsys/logging/Kconfig.template.log_config"

endif

endmenu
```

## applications/nrf_desktop/src/modules/Kconfig.fast_pair
```kconfig
#
# Copyright (c) 2022 Nordic Semiconductor ASA
#
# SPDX-License-Identifier: LicenseRef-Nordic-5-Clause
#

menuconfig DESKTOP_FAST_PAIR
	bool "Fast Pair module"
	depends on BT_ADV_PROV_FAST_PAIR
	depends on CAF_BLE_BOND_SUPPORTED
	depends on (CAF_BLE_STATE_BONDS_PER_LOCAL_ID > 1)
	default y
	help
	  Enable a small application module that control Fast Pair show/hide UI
	  indication during Fast Pair not discoverable advertising.

if DESKTOP_FAST_PAIR

config DESKTOP_FAST_PAIR_BONDS_PER_LOCAL_ID
	int
	default CAF_BLE_STATE_BONDS_PER_LOCAL_ID

module = DESKTOP_FAST_PAIR
module-str = nRF Desktop Fast Pair
source "subsys/logging/Kconfig.template.log_config"

endif # DESKTOP_FAST_PAIR
```

## applications/nrf_desktop/src/modules/Kconfig.led_stream
```kconfig
#
# Copyright (c) 2019 Nordic Semiconductor
#
# SPDX-License-Identifier: LicenseRef-BSD-5-Clause-Nordic
#

if DESKTOP_LED_ENABLE && DESKTOP_CONFIG_CHANNEL_ENABLE

menu "LED stream"

config DESKTOP_LED_STREAM_ENABLE
	bool "Enable led stream"
	depends on DESKTOP_LED_ENABLE
	help
	  Enable RGB led effect streaming.

module = DESKTOP_LED_STREAM
module-str = LED stream
source "subsys/logging/Kconfig.template.log_config"

endmenu

endif
```

## lib/edge_impulse/Kconfig
```kconfig
#
# Copyright (c) 2020 Nordic Semiconductor ASA
#
# SPDX-License-Identifier: LicenseRef-BSD-5-Clause-Nordic
#

menuconfig EDGE_IMPULSE
	bool "Enable Edge Impulse"
	depends on CPLUSPLUS
	depends on STD_CPP11
	depends on LIB_CPLUSPLUS
	depends on NEWLIB_LIBC
	depends on NEWLIB_LIBC_FLOAT_PRINTF
	depends on FPU
	help
	  Enable Edge Impulse library.

if EDGE_IMPULSE

choice
	prompt "Select Edge Impulse library source"
	default EDGE_IMPULSE_BUILD_FROM_ZIP

config EDGE_IMPULSE_BUILD_FROM_ZIP
	bool "Build Edge Impulse library from provided zip file"
	help
	  Make sure to specify the zip path as EDGE_IMPULSE_ZIP_PATH Kconfig
	  option.

config EDGE_IMPULSE_BUILD_FROM_URI
	bool "Download Edge Impulse library from URI and build it"
	help
	  Make sure to specify the URI as EDGE_IMPULSE_DOWNLOAD_URI Kconfig
	  option and provide API key header as EI_API_KEY_HEADER variable
	  during build (if required by the HTTP server).

endchoice

config EDGE_IMPULSE_ZIP_PATH
	string "Edge Impulse library zip path"
	depends on EDGE_IMPULSE_BUILD_FROM_ZIP
	default ''
	help
	  Specify path for *.zip file containing the Edge Impulse library.
	  Path is relative to application source directory.

config EDGE_IMPULSE_DOWNLOAD_URI
	string "Edge Impulse library download URI"
	depends on EDGE_IMPULSE_BUILD_FROM_URI
	default ''
	help
	  Specify URI used to download archive with Edge Impulse library.
	  The library will be downloaded into build directory. Make sure
	  to specify the HTTP API key header as EI_API_KEY_HEADER variable
	  during build if the HTTP server uses it.

endif # EDGE_IMPULSE
```

## modules/coremark/Kconfig
```kconfig
#
# Copyright (c) 2023 Nordic Semiconductor
#
# SPDX-License-Identifier: LicenseRef-Nordic-5-Clause
#

menuconfig COREMARK
	bool "CoreMark benchmark"

if COREMARK

config COREMARK_ITERATIONS
	int "Number of the iterations to run"
	range 10 10000
	default 1000
	help
	  Specify the number of the iterations to run the benchmark.
	  CoreMark should execute for at least 10 seconds to have valid results.
	  The minimum number of iterations depends on the platform and its configuration.

config COREMARK_THREADS_NUMBER
	int "Number of the threads for the parallel benchmark execution"
	default 1
	range 1 4
	range 1 1 if COREMARK_MEMORY_METHOD_STATIC
	help
	  Specify the number of the threads to use for the CoreMark execution.
	  1 - means the execution only from the main thread.

choice COREMARK_RUN_TYPE
	prompt "Coremark run type"
	default COREMARK_RUN_TYPE_PERFORMANCE
	help
	   Specify the purpose of the CoreMark execution. The required memory size may vary
	   depending on the type.

config COREMARK_RUN_TYPE_PERFORMANCE
	bool "Performance run"

config COREMARK_RUN_TYPE_PROFILE
	bool "Profile run"

config COREMARK_RUN_TYPE_VALIDATION
	bool "Validation run"

endchoice # COREMARK_RUN_TYPE

config COREMARK_DATA_SIZE
	int "Total size for the data algorithms will operate on"
	default 500 if COREMARK_RUN_TYPE_VALIDATION
	default 1200 if COREMARK_RUN_TYPE_PROFILE
	default 2000 if COREMARK_RUN_TYPE_PERFORMANCE
	range 100 2000
	help
	  Specify the size for the data algorithms. You can choose different values
	  for it. For registering your results, you need to
	  run CoreMark with default values for PROFILE and PERFORMANCE run types.

choice COREMARK_MEMORY_METHOD
	prompt "Memory Method"
	default COREMARK_MEMORY_METHOD_STACK
	help
	  This option defines the method to get a block of memory.

config COREMARK_MEMORY_METHOD_STACK
	bool "Stack"
	help
	  The main thread stack is used for this memory method. Make sure that there
	  is enough memory allocated with MAIN_STACK_SIZE option. The size depends
	  on the size of data that CoreMark operates on and number of threads. It should
	  be higher than:
	    COREMARK_DATA_SIZE * COREMARK_THREADS_NUMBER + main thread context.

config COREMARK_MEMORY_METHOD_STATIC
	bool "Static"

config COREMARK_MEMORY_METHOD_MALLOC
	bool "Malloc"
	help
	  To use this option, you need to set up the system heap size using the
	  HEAP_MEM_POOL_SIZE option. The size depends on the number of parallel
	  contexts executed and COREMARK_RUN_TYPE. It should be higher than
	  COREMARK_DATA_SIZE * COREMARK_THREADS_NUMBER.

endchoice # COREMARK_MEMORY_METHOD

endif
```

## samples/benchmarks/coremark/boards/Kconfig.sysbuild_nrf5340dk_nrf5340_cpuapp
```kconfig
#
# Copyright (c) 2023 Nordic Semiconductor ASA
#
# SPDX-License-Identifier: LicenseRef-Nordic-5-Clause
#

config CM_NETWORK_CORE
	bool ""Build coremark for network core"
	default y

config IMAGE_2_BOARD
	default "nrf5340dk_nrf5340_cpunet" if CM_NETWORK_CORE
```

## samples/bluetooth/fast_pair/locator_tag/src/Kconfig.dfu
```kconfig
#
# Copyright (c) 2024 Nordic Semiconductor
#
# SPDX-License-Identifier: LicenseRef-Nordic-5-Clause
#

config APP_DFU
	bool "MCUmgr & SMP BT DFU support"
	select NCS_SAMPLE_MCUMGR_BT_OTA_DFU
	select MCUMGR_MGMT_NOTIFICATION_HOOKS
	select MCUMGR_SMP_COMMAND_STATUS_HOOKS
	depends on BOOTLOADER_MCUBOOT
	help
	  Enable support for Device Firmware Update (DFU) over MCUmgr & SMP BT.

if APP_DFU

config NRF53_UPGRADE_NETWORK_CORE
	default y

# Do not allow for settings erase through MCUmgr. */
config MCUMGR_GRP_ZBASIC
	default n

config MCUMGR_GRP_ZBASIC_STORAGE_ERASE
	default n

config MCUMGR_TRANSPORT_BT_DYNAMIC_SVC_REGISTRATION
	default n

endif # APP_DFU
```

## samples/edge_impulse/wrapper/sample.yaml
```yaml
sample:
  description: Sample showing Edge Impulse wrapper usage
  name: Edge Impulse wrapper sample
common:
  harness: console
  integration_platforms:
    - qemu_cortex_m3
  platform_exclude: native_posix qemu_x86
  harness_config:
    type: one_line
    ordered: True
    regex:
     - "Classification results"
     - "Value: (1[.]0[0-9]+)|(0[.]9[0-9]+)\tLabel: sine"
     - "Value: 0[.]0[0-9]+\tLabel: triangle"
     - "Value: 0[.]0[0-9]+\tLabel: idle"
     - "Anomaly: 5"
tests:
  samples.edge_impulse.wrapper:
    build_only: false
```

## subsys/bluetooth/adv/Kconfig
```kconfig
#
# Copyright (c) 2022 Nordic Semiconductor ASA
#
# SPDX-License-Identifier: LicenseRef-Nordic-5-Clause
#

menuconfig NRF_BT_ADV
	bool "nRF Bluetooth advertising"
	depends on BT_PERIPHERAL
	help
	  Enable nRF Bluetooth advertisng subsystem. The subsystem manages
	  advertising packets and scan response packets. It does not control
	  advertising start and stop.

if NRF_BT_ADV

module = NRF_BT_ADV
module-str = nRF Bluetooth advertising module
source "${ZEPHYR_BASE}/subsys/logging/Kconfig.template.log_config"

rsource "providers/Kconfig"

endif # NRF_BT_ADV
```

## subsys/bluetooth/adv/providers/Kconfig.flags
```kconfig
#
# Copyright (c) 2022 Nordic Semiconductor ASA
#
# SPDX-License-Identifier: LicenseRef-Nordic-5-Clause
#

config NRF_BT_ADV_PROV_FLAGS
	bool "Advertising flags"
	help
	  Add Bluetooth advertising flags to advertising data.
```

## subsys/bluetooth/adv/providers/Kconfig.gap_appearance
```kconfig
#
# Copyright (c) 2022 Nordic Semiconductor ASA
#
# SPDX-License-Identifier: LicenseRef-Nordic-5-Clause
#

menuconfig NRF_BT_ADV_PROV_GAP_APPEARANCE
	bool "GAP appearance"
	help
	  Add GAP appearance to advertising data.

if NRF_BT_ADV_PROV_GAP_APPEARANCE

config NRF_BT_ADV_PROV_GAP_APPEARANCE_VAL
	int "Advertised device appearance"
	range 0 65535
	default BT_DEVICE_APPEARANCE

endif # NRF_BT_ADV_PROV_GAP_APPEARANCE
```

## subsys/bluetooth/adv/providers/Kconfig.swift_pair
```kconfig
#
# Copyright (c) 2022 Nordic Semiconductor ASA
#
# SPDX-License-Identifier: LicenseRef-Nordic-5-Clause
#

config NRF_BT_ADV_PROV_SWIFT_PAIR
	bool "Microsoft Swift Pair"
	help
	  Add Microsoft Swfit Pair manufacturer data to advertising data.

if NRF_BT_ADV_PROV_SWIFT_PAIR

config NRF_BT_ADV_PROV_SWIFT_PAIR_GRACE_PERIOD
	int "Swift Pair grace period [s]"
	default 30
	help
	  To ensure users will not try to connect to a device which is no longer available,
	  Swift Pair vendor section will be removed before exiting from advertising mode.

endif # NRF_BT_ADV_PROV_SWIFT_PAIR
```

## subsys/bluetooth/adv/providers/Kconfig.tx_power
```kconfig
#
# Copyright (c) 2022 Nordic Semiconductor ASA
#
# SPDX-License-Identifier: LicenseRef-Nordic-5-Clause
#

config NRF_BT_ADV_PROV_TX_POWER
	bool "TX power"
	select BT_CTLR_TX_PWR_DYNAMIC_CONTROL
	help
	  Add TX power to advertising data. Proviver reads the advertising TX
	  power from Bluetooth controller.
```
