## applications/nrf_desktop/src/events/Kconfig
```kconfig
#
# Copyright (c) 2025 Nordic Semiconductor ASA
#
# SPDX-License-Identifier: LicenseRef-Nordic-5-Clause
#

menu "Application events"

config DESKTOP_HID_REPORT_PROVIDER_EVENT
	bool "HID report provider events"
	help
	  Enable HID report provider events in nRF Desktop application.

config DESKTOP_HID_REPORT_SYNC_EVENT
	bool "HID report synchronization events"
	help
	  Enable HID report synchronization events in nRF Desktop application.
	  The events are used to synchronize sampling sensors to HID input
	  report transmission.

rsource "Kconfig.log"

endmenu
```

## applications/nrf_desktop/src/modules/Kconfig.hid_provider_mouse
```kconfig
#
# Copyright (c) 2025 Nordic Semiconductor ASA
#
# SPDX-License-Identifier: LicenseRef-Nordic-5-Clause
#

menuconfig DESKTOP_HID_REPORT_PROVIDER_MOUSE
	bool "HID mouse report provider (default)"
	default y
	depends on DESKTOP_HID_REPORT_MOUSE_SUPPORT
	select DESKTOP_HID_KEYMAP
	help
	  Disable this option if you want to use a custom HID mouse report
	  provider. Make sure to either disable HID mouse report support or
	  enable a custom HID mouse provider if you disable this option.

if DESKTOP_HID_REPORT_PROVIDER_MOUSE

module = DESKTOP_HID_REPORT_PROVIDER_MOUSE
module-str = HID mouse provider
source "subsys/logging/Kconfig.template.log_config"

endif # DESKTOP_HID_REPORT_PROVIDER_MOUSE
```
